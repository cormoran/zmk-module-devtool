## Kconfig
```kconfig
config ZMK_DEVTOOL
    bool "Enable ZMK Devtool module"

if ZMK_DEVTOOL

config ZMK_DEVTOOL_STUDIO_RPC
    bool "Enable ZMK Devtool custom Studio RPC"
    depends on ZMK_STUDIO

if ZMK_DEVTOOL_STUDIO_RPC

config ZMK_DEVTOOL_LAYER_STATE
    bool "Enable runtime layer state RPCs (get/set/toggle layer)"
    default y

config ZMK_DEVTOOL_KEY_INJECTION
    bool "Enable virtual key injection RPCs (inject_key/tap_key)"
    help
      Lets Studio RPC callers simulate key presses without physical input,
      by raising the same zmk_position_state_changed event a real matrix
      scan would. Enable only in development/test firmware.

config ZMK_DEVTOOL_EVENT_TAP
    bool "Enable event tap RPCs (subscribe/get/clear events)"
    help
      Records position/keycode/layer/modifier state-changed events into a
      RAM ring buffer for polling over Studio RPC, so calls can verify what
      an injected key (or a real one) did. This can observe every keystroke
      -- development/test firmware only.

if ZMK_DEVTOOL_EVENT_TAP

config ZMK_DEVTOOL_EVENT_TAP_BUFFER_SIZE
    int "Event tap ring buffer capacity (records)"
    default 32

endif # ZMK_DEVTOOL_EVENT_TAP

config ZMK_DEVTOOL_LOG_CAPTURE
    bool "Enable log capture RPCs (get_logs/clear_logs/set_log_capture_filter)"
    select LOG
    select LOG_OUTPUT
    select LOG_RUNTIME_FILTERING
    help
      Adds a Zephyr log backend that stores formatted log records in a RAM
      ring buffer, retrievable over Studio RPC without a debug probe.
      Selects LOG (production keyboard builds often leave it off) and
      LOG_RUNTIME_FILTERING: without the latter every backend receives every
      compiled-in log message unconditionally, which would defeat the
      default-level self-feedback-loop mitigation below. Incompatible with
      CONFIG_LOG_MODE_MINIMAL (no backend/runtime-filtering support there);
      LOG_RUNTIME_FILTERING's own Kconfig dependency already excludes it.

if ZMK_DEVTOOL_LOG_CAPTURE

config ZMK_DEVTOOL_LOG_CAPTURE_BUFFER_SIZE
    int "Log capture ring buffer capacity (records)"
    default 64
    help
      Number of recent log records retained in the RAM ring buffer. Each
      record is ~80 bytes (see LogRecord source/message max_size), so the
      default costs a few KB. Larger buffers tolerate slower pollers /
      bigger bursts before dropping records.

config ZMK_DEVTOOL_LOG_CAPTURE_DEFAULT_LEVEL
    int "Default minimum captured log level (1=err 2=wrn 3=inf 4=dbg)"
    default 3
    range 1 4
    help
      Default INF (3) deliberately excludes the DBG-level Studio RPC
      dispatch/transport logging, so calling get_logs does not feed its own
      chatter back into the buffer it just read from. Raise a specific
      source to DBG at runtime with set_log_capture_filter instead of
      lowering this default.

config ZMK_DEVTOOL_LOG_CAPTURE_STREAMING
    bool "Enable streaming log notifications (push instead of poll)"
    default y
    select ZMK_LOW_PRIORITY_WORK_QUEUE
    help
      Adds the set_log_streaming RPC. When enabled, a periodic work item on
      ZMK's low-priority work queue drains newly captured records and pushes
      them to the connected Studio client as custom notifications, so the
      client does not have to poll get_logs. The notification + protobuf
      encoding runs on the low-priority work queue, never on the logging
      subsystem's own thread.

if ZMK_DEVTOOL_LOG_CAPTURE_STREAMING

# The streaming work item raises a Studio notification, which runs the full RPC
# response encode + transmit path on the shared low-priority work queue. ZMK's
# 768-byte default is far too small for that nanopb encode, so raise the floor
# (a keyboard config can still override this explicitly).
config ZMK_LOW_PRIORITY_THREAD_STACK_SIZE
    default 2048

config ZMK_DEVTOOL_LOG_CAPTURE_STREAM_INTERVAL_MS
    int "Log streaming poll interval (milliseconds)"
    default 50
    help
      How often the low-priority work item wakes to drain and push newly
      captured log records while streaming is enabled. Lower is more
      responsive but wakes the work queue more often. This interval only
      governs the wait after the backlog is fully drained; while records are
      still pending the work re-enqueues itself immediately (see
      ZMK_DEVTOOL_LOG_CAPTURE_STREAM_MAX_RECORDS_PER_WORK).

config ZMK_DEVTOOL_LOG_CAPTURE_STREAM_MAX_RECORDS_PER_WORK
    int "Max log records pushed per work-queue invocation"
    default 30
    help
      Upper bound on how many captured records a single streaming work
      invocation pushes before it yields the shared low-priority work queue.
      Without a cap, a sustained log flood keeps the drain loop running
      indefinitely (new records arrive faster than, or as fast as, they are
      sent), monopolizing the queue and starving other low-priority work.
      When the cap is hit with records still buffered, the work re-enqueues
      itself with no delay (not after STREAM_INTERVAL_MS), so throughput is
      preserved while other work on the queue gets a turn. Rounds up to a
      whole notification batch, so at least one batch is always sent.

endif # ZMK_DEVTOOL_LOG_CAPTURE_STREAMING

endif # ZMK_DEVTOOL_LOG_CAPTURE

config ZMK_DEVTOOL_STUDIO_RPC_TEST
    bool "Enable devtool Studio RPC self-test (native_sim only)"
    help
      Adds test-only init logic exercising the layer state, key injection,
      event tap and log capture RPC handlers directly (no transport). Needs
      CONFIG_ZMK_STUDIO, which in turn needs a physical-layout devicetree
      (see tests/studio/ vs tests/test/). Not for production builds.

endif # ZMK_DEVTOOL_STUDIO_RPC

endif
```
